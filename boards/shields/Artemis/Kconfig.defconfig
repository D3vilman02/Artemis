## boards/shields/Artemis/Kconfig.defconfig
```kconfig
if SHIELD_ARTEMIS_LEFT

config ZMK_KEYBOARD_NAME
    default "Artemis"

config ZMK_SPLIT_ROLE_CENTRAL
    default y

endif

if SHIELD_ARTEMIS_LEFT || SHIELD_ARTEMIS_RIGHT

config ZMK_SPLIT
    default y

endif
```
